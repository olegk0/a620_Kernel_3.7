## arch/arm/mach-pxa/asus620/Kconfig
```kconfig
menuconfig MACH_A620
	bool "Enable support for ASUS MyPal a620"
	select PXA25x
	select HAVE_PWM
	help
	  Say Y here if you want to enable support for a620 device.
	  ASUS MyPal a620 has 64MB RAM and 32MB flash and QVGA touchscreen.
	  Originally was shipped with Windows CE.

config A620_DOC
        tristate "A620 DiskOnChip RO only"
        depends on MACH_A620 && MTD && BLOCK && MTD_NAND && HAS_IOMEM
	select MTD_BLKDEVS
	select REED_SOLOMON
	select REED_SOLOMON_DEC16
        help
          This enables support for using the internal flash disk
          on MyPal in RO mode.
```
